## CMakeLists.txt
```
cmake_minimum_required(VERSION 3.13.1)
find_package(Zephyr REQUIRED HINTS $ENV{ZEPHYR_BASE})
project(luos_sample_on_zephyr)

target_sources(app PRIVATE src/main.c)
target_sources(app PRIVATE lib/led/led.c)
target_include_directories(app PRIVATE lib/led)
```

## prj.conf
```kconfig
CONFIG_PRINTK=y
CONFIG_CBPRINTF_FP_SUPPORT=y

CONFIG_SHELL=y
CONFIG_SHELL_HISTORY=y
CONFIG_SHELL_VT100_COLORS=y

CONFIG_LOG=y
CONFIG_LOG_DEFAULT_LEVEL=4
CONFIG_NEWLIB_LIBC=y

#Enables Luos:
CONFIG_LUOS=y
```

## boards/nucleo_g474re.conf
```kconfig
CONFIG_PTPA_PIN_NBR=0
CONFIG_PTPB_PIN_NBR=1
CONFIG_TX_PIN_NBR=4
CONFIG_RX_PIN_NBR=5

# Necessary to disable, since Luos redefines some macros.
CONFIG_ARM_MPU=n
```

## boards/nucleo_g474re.overlay
```dts
&usart1 {
	current-speed = <921600>;
	status = "okay";
};
```

## src/main.c
```c
#include <zephyr/kernel.h>
#include <luos_engine.h>
#include <led.h>

int main(void)
{
    Luos_Init();
    Led_Init();
    while (1)
    {
        Luos_Loop();
        Led_Loop();
        k_sleep(K_MSEC(10));
        printk("Spining Luos Engine each 10 ms \n");
    }
}
```
